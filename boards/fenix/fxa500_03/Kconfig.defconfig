## boards/fenix/fxa500_03/Kconfig.defconfig
```kconfig
# SPDX-License-Identifier: Apache-2.0
#
# Copyright (c) 2024 BaDen (baden.i.ua@gmail.com)

if BOARD_FXA500_03

config BOARD
	default "fxa500_03"


# Здається з esp-hosted нічого не вийде, бо для нього треба SPI або SDIO
if NETWORKING

config WIFI_ESP_HOSTED
	default y

endif # NETWORKING


if MODEM_CELLULAR

config MODEM_CELLULAR_PREINIT_PRIORITY
	int "Cellular modem driver initialization priority"
	default 69
	range 0 99
	help
	  Driver pre-initialization priority for cellular modem drivers.
	  Defaults to less than POST_KERNEL/MODEM_CELLULAR_INIT_PRIORITY.
	  But greater than GPIO/Driver.

endif # MODEM_CELLULAR

if GNSS

config BOARD_FXA500_03_GPS_POWER_INIT_PRIORITY
	int "GPS modem driver initialization priority"
	default 79
	range 0 99
	help
	  Driver pre-initialization priority for gnss modem drivers.
	  Defaults to less than POST_KERNEL/GNSS_INIT_PRIORITY (80).
	  But greater than GPIO/Driver.

endif # GNSS

endif
```

## dts/bindings/simcom,sim65m.yaml
```yaml
# Copyright (C) 2025 Olivier Lalonde
# SPDX-License-Identifier: Apache-2.0

description: Simcom SIM65M GPS driver

compatible: "simcom,sim65m"

include: gnss-nmea-generic.yaml

properties:
  gps-pwr-gpios:
    type: phandle-array
    required: true
```
