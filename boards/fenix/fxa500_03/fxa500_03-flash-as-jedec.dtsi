/* Declare external Flash as memory-mapped over jedec,spi-nor (Це не працює!) */
&xspi1 {
	w25q128jv: spi-nor-flash@0 {
		compatible = "jedec,spi-nor";
		reg = <0>;
		spi-max-frequency = <DT_FREQ_M(133)>;
		size = <DT_SIZE_M(128)>; /* 128 Mbits */
		status = "okay";
		jedec-id = [ef 40 18];
		has-dpd;
		t-enter-dpd = <3500>;
		t-exit-dpd = <3500>;

		// status = "okay";

		// jedec-id = [ef 40 18];
		// size = <DT_SIZE_M(128)>; /* 128 Mbits */

		// spi-bus-width = <XSPI_QUAD_MODE>;
		// data-rate = <XSPI_STR_TRANSFER>;

		// /* Явно вказуємо кількість тактів очікування для читання. Критично для MMAP! */
		// use-fast-read;
		// read-dummy-cycles = <8>;

		// /* Стандартні параметри для запису */
		// writeoc = "PP_1_1_4";
		requires-ulbpr;

		/* Активація Memory-Mapped режиму через стандартний механізм DT */
		#address-cells = <1>;
		#size-cells = <1>;
		// ranges = <0x0 0x90000000 DT_SIZE_MB(16)>;
		ranges = <0x0 0x90000000 DT_SIZE_M(16)>; /* Ext Flash mem-mapped to 0x90000000 */

		partitions {
			compatible = "fixed-partitions";
			#address-cells = <1>;
			#size-cells = <1>;

			extflash_partition: partition@0 {
				label = "ext_storage";
				reg = <0x00000000 DT_SIZE_M(16)>;
			};
		};
	};
};
