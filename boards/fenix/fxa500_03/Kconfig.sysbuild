## boards/fenix/fxa500_03/Kconfig.sysbuild
```kconfig
# SPDX-FileCopyrightText: Copyright The Zephyr Project Contributors
# SPDX-License-Identifier: Apache-2.0

choice BOOTLOADER
	default BOOTLOADER_MCUBOOT
endchoice

choice BOOT_SIGNATURE_TYPE
	default BOOT_SIGNATURE_TYPE_NONE
endchoice

if BOARD_FXA500_03_EXT_FLASH_APP

choice MCUBOOT_MODE
	default MCUBOOT_MODE_SWAP_USING_OFFSET
endchoice

endif # BOARD_FXA500_03_EXT_FLASH_APP
```

## boards/fenix/fxa500_03/board.yml
```yaml
board:
  name: fxa500_03
  vendor: fenix
  socs:
    - name: stm32h563xx
      variants:
        - name: ext_flash_app
    #- name: esp32c6-mini
  # revision:
  #   format: <major.minor.patch|letter|number|custom>
  #   default: <default-revision-value>
  #   exact: <true|false>
  #   revisions:
  #   - name: <revA>
  #   - name: <revB>
```

## dts/bindings/simcom,a76xx-at.yaml
```yaml
# Copyright (C) 2025 Olivier Lalonde
# SPDX-License-Identifier: Apache-2.0

description: Simcom A76XX modem for AT driver

compatible: "simcom,a76xx-at"

include: zephyr,cellular-modem-device.yaml

properties:
  mdm-vbat-gpios:
    type: phandle-array
    required: true
  mdm-status-gpios:
    type: phandle-array
    required: true
```
